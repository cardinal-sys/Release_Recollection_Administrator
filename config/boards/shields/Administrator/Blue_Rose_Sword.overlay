/* ===============================
 * Blue_Rose_Sword.overlay
 * 〈青薔薇の剣〉— 左手・peripheral
 *   - ユージオ神器・青薔薇の剣
 *   - EC11 ロータリーエンコーダー搭載
 *   - col-gpios 7列（cols 0–6、col-offset なし）
 * =============================== */

#include "Administrator.dtsi"

/* col-offset は Night_Sky_Sword（右・central）側で設定する */

&kscan0 {
    wakeup-source;
    col-gpios
        = <&xiao_d 10 GPIO_ACTIVE_HIGH>
        , <&xiao_d 9  GPIO_ACTIVE_HIGH>
        , <&xiao_d 8  GPIO_ACTIVE_HIGH>
        , <&xiao_d 7  GPIO_ACTIVE_HIGH>
        , <&gpio0 10  GPIO_ACTIVE_HIGH>
        , <&gpio0 9   GPIO_ACTIVE_HIGH>
        , <&xiao_d 4  GPIO_ACTIVE_HIGH>
        ;
};

&left_encoder {
    status = "okay";
};

&sensors {
    status = "okay";
};
