## config/boards/shields/Administrator/Kconfig.defconfig
```kconfig
if SHIELD_RED_ROSE_SWORD

config ZMK_KEYBOARD_NAME
    default "Red Rose Sword"

config ZMK_SPLIT
    default y

config ZMK_SPLIT_ROLE_CENTRAL
    default y

endif

if SHIELD_BLUE_ROSE_SWORD

config ZMK_KEYBOARD_NAME
    default "Blue Rose Sword"

config ZMK_SPLIT
    default y

endif
```

## config/boards/shields/Administrator/Kconfig.shield
```kconfig
config SHIELD_RED_ROSE_SWORD
    def_bool $(shields_list_contains,Red_Rose_Sword)

config SHIELD_BLUE_ROSE_SWORD
    def_bool $(shields_list_contains,Blue_Rose_Sword)
```
