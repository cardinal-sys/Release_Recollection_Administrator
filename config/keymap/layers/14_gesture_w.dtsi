/* ============================================================
 * layers/14_gesture_w.dtsi Ã¢ÂÂ [ Synthesis 14 ] GESTURE_W
 * ============================================================ */

GESTURE_W {
    bindings = <
    &trans  &trans  &trans  &trans  &trans  &trans  &trans  &trans  &kp LEFT_SHIFT  &trans  &trans  &trans  &trans  &trans  &trans  &trans  &trans  &trans  &trans  &trans  &trans  &trans  &kp LEFT_SHIFT  &kp LEFT_SHIFT  &trans  &trans  &trans  &trans  &trans  &trans  &trans  &trans  &trans  &trans  &trans  &trans  &trans  &trans  &trans  &trans  &trans  &trans  &trans  &trans  &kp LEFT_SHIFT  &kp LEFT_SHIFT  &kp LEFT_SHIFT  &trans  &trans  &trans  &trans
    >;
};
