/* ============================================================
 * layers/03_num.dtsi Ã¢ÂÂ [ Synthesis 03 ] NUM
 * ============================================================ */

NUM {
    bindings = <
    &trans  &trans  &kp LA(LC(V))  &kp LG(LS(NUMBER_3))  &kp LG(LS(NUMBER_4))  &trans  &kp 0x0059  &kp 0x005a  &kp 0x005b  &kp 0x005c  &kp 0x005d  &trans  &trans  &kp LG(A)  &kp LG(X)  &kp LG(C)  &kp LG(V)  &kp END  &trans  &kp EQUAL  &kp 0x005e  &kp 0x005f  &kp 0x0060  &kp 0x0061  &kp 0x0062  &trans  &trans  &trans  &trans  &kp LG(Z)  &kp LG(Y)  &trans  &trans  &kp LS(EQUAL)  &kp MINUS  &kp LS(NUMBER_8)  &kp SLASH  &kp PERIOD  &kp COMMA  &trans  &trans  &trans  &trans  &trans  &trans  &trans  &trans  &kp BACKSPACE  &kp ENTER  &kp RG(Z)  &trans
    >;

    sensor-bindings = <&inc_dec_kp C_BRI_DN C_BRI_UP>;
};
