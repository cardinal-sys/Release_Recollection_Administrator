/* ============================================================
 * layers/13_gesture_d.dtsi Ã¢ÂÂ [ Synthesis 13 ] GESTURE_D
 * ============================================================ */

GESTURE_D {
    bindings = <
    &trans  &trans  &trans  &trans  &trans  &trans  &trans  &trans  &kp LEFT_SHIFT  &trans  &trans  &trans  &trans  &trans  &trans  &trans  &trans  &trans  &trans  &trans  &trans  &trans  &kp LEFT_SHIFT  &kp LEFT_SHIFT  &trans  &trans  &trans  &trans  &trans  &trans  &trans  &trans  &trans  &trans  &trans  &trans  &trans  &trans  &trans  &trans  &trans  &trans  &trans  &trans  &kp LEFT_SHIFT  &kp LEFT_SHIFT  &kp LEFT_SHIFT  &trans  &trans  &trans  &trans
    >;
};
