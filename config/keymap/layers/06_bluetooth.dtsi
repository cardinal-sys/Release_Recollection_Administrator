/* ============================================================
 * layers/06_bluetooth.dtsi â [ Synthesis 06 ] Bluetooth
 * ============================================================ */

Bluetooth {
    bindings = <
    &trans  &trans  &trans  &trans  &trans  &trans  &bt_solo_0 0  &bt_solo_1 0  &bt_solo_2 0  &bt_solo_3 0  &bt_solo_4 0  &trans  &trans  &trans  &trans  &trans  &trans  &trans  &trans  &studio_unlock  &bt_pair_0 0  &bt_pair_1 0  &bt_pair_2 0  &bt_pair_3 0  &bt_pair_4 0  &trans  &trans  &trans  &trans  &trans  &trans  &kp LG(LA(ESC))  &kp LG(LC(Q))  &bootloader  &trans  &trans  &trans  &trans  &bluetooth 0  &trans  &trans  &trans  &trans  &trans  &trans  &trans  &trans  &trans  &trans  &bluetooth 4  &trans
    >;

    sensor-bindings = <&rotate>;
};
