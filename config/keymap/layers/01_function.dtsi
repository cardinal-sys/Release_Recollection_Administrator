/* ============================================================
 * layers/01_function.dtsi â [ Synthesis 01 ] FUNCTION
 * ============================================================ */

FUNCTION {
    bindings = <
    &trans  &kp F5  &kp F4  &kp F3  &kp F2  &kp F1  &kp LS(RIGHT_ARROW)  &kp LEFT_ARROW  &kp UP_ARROW  &kp RIGHT_ARROW  &kp LC(TAB)  &trans  &trans  &kp F10  &kp F9  &kp F8  &kp F7  &kp F6  &kp ESC  &kp LS(LEFT_ARROW)  &kp LEFT_ARROW  &kp LEFT_ARROW  &kp DOWN_ARROW  &kp RIGHT_ARROW  &kp LS(LC(TAB))  &trans  &trans  &mt RG(RA(RS(LEFT_CONTROL))) F11  &kp F17  &kp F16  &kp F15  &kp F14  &kp F13  &kp RG(A)  &kp RG(M)  &kp RG(Q)  &kp RG(W)  &kp RG(P)  &kp RG(RS(NUMBER_5))  &trans  &trans  &mt RG(RA(RIGHT_SHIFT)) F12  &mt RG(RA(RS(LS(LEFT_CONTROL)))) F19  &mt RG(RA(RS(LEFT_SHIFT))) F18  &kp CAPS  &kp F20  &kp LG(BACKSPACE)  &kp BACKSPACE  &trans  &kp RG(RS(NUMBER_4))  &trans
    >;

    sensor-bindings = <&inc_dec_kp RIGHT_ARROW LEFT_ARROW>;
};
