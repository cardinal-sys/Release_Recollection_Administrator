/* ============================================================
 * layers/04_mouse.dtsi â [ Synthesis 04 ] MOUSE
 * ============================================================ */

MOUSE {
    bindings = <
    &trans  &mouse_move 4255645696  &mouse_move 600  &mouse_move 64936  &mouse_move 39321600  &kp LG(T)  &kp LG(Z)  &kp LG(RIGHT_BRACKET)  &gesture_mo_kp 5 LEFT_BRACKET  &kp LG(A)  &kp LC(H)  &trans  &trans  &mouse_scroll 39321600  &mouse_scroll 600  &mouse_scroll 64936  &mouse_scroll 4255645696  &arrows_alt 6  &mkp MB1  &safari_reload_once 0  &mkp MB3  &mkp MB2  &mkp MB1  &trans  &gesture_mo_kp 5 ENTER  &trans  &trans  &mt RG(RA(RS(LEFT_CONTROL))) HOME  &kp END  &kp DOWN_ARROW  &kp UP_ARROW  &kp LEFT_ARROW  &kp RIGHT_ARROW  &kp LG(C)  &kp LG(V)  &kp UP_ARROW  &drag_off 0  &kp LG(X)  &gesture_mo_kp 5 BACKSPACE  &trans  &trans  &kp LG(P)  &kp LG(RIGHT_BRACKET)  &kp LG(LEFT_BRACKET)  &arrows_alt 2  &arrows_alt 3  &kp TAB  &drag_on 0  &kp DOWN_ARROW  &trans  &trans
    >;

    sensor-bindings = <&rotate>;
};
