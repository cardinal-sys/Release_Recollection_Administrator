/* ============================================================
 * layers/16_num_smart.dtsi — [ Synthesis 16 ] NUM_SMART
 * ============================================================ */

NUM_SMART {
    bindings = <
    &trans  &kp 0x005d  &kp 0x005c  &kp 0x005b  &kp 0x005a  &kp 0x0059  &kp 0x0059  &kp 0x005a  &kp 0x005b  &kp 0x005c  &kp 0x005d  &trans  &trans  &kp 0x0062  &kp 0x0061  &kp 0x0060  &kp 0x005f  &kp 0x005e  &trans  &kp EQUAL  &kp 0x005e  &kp 0x005f  &kp 0x0060  &kp 0x0061  &kp 0x0062  &trans  &trans  &mt RG(RA(RS(LEFT_CONTROL))) COMMA  &kp PERIOD  &kp SLASH  &kp LS(NUMBER_8)  &kp MINUS  &kp LS(EQUAL)  &kp LS(EQUAL)  &kp MINUS  &kp LS(NUMBER_8)  &kp SLASH  &kp PERIOD  &kp COMMA  &trans  &trans  &trans  &trans  &trans  &trans  &trans  &trans  &kp BACKSPACE  &kp ENTER  &tog 16  &trans
    >;

    sensor-bindings = <&inc_dec_kp C_BRI_DN C_BRI_UP>;
};
